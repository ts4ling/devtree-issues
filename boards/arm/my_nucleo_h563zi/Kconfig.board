## boards/arm/my_nucleo_h563zi/Kconfig.board
```kconfig
# STM32H563ZI Nucleo board configuration

# Copyright (c) 2023 Thomas Stranger
# SPDX-License-Identifier: Apache-2.0

config BOARD_MY_NUCLEO_H563ZI
	bool "MY NUCLEO H563ZI Board"
	depends on SOC_STM32H563XX
```

## boards/arm/my_nucleo_h563zi/Kconfig.defconfig
```kconfig
# STM32H563ZI Nucleo board configuration

# Copyright (c) 2023 Thomas Stranger
# SPDX-License-Identifier: Apache-2.0

if BOARD_MY_NUCLEO_H563ZI

config BOARD
	default "my_nucleo_h563zi"

if NETWORKING

config NET_L2_ETHERNET
	default n

endif # NETWORKING

endif # BOARD_MY_NUCLEO_H563ZI
```
